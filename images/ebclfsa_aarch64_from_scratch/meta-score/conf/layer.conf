## images/ebclfsa_aarch64_from_scratch/meta-score/conf/layer.conf
```bitbake
# Copyright (c) 2026 Contributors to the Eclipse Foundation
# SPDX-License-Identifier: Apache-2.0

BBPATH .= ":${LAYERDIR}"
BBFILES += "${LAYERDIR}/recipes-*/*/*.bb ${LAYERDIR}/recipes-*/*/*.bbappend"
BBFILE_COLLECTIONS += "score"
BBFILE_PATTERN_score = "^${LAYERDIR}/"
BBFILE_PRIORITY_score = "10"
LAYERSERIES_COMPAT_score = "next"
```
